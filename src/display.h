#ifndef QUALITYGATE_DISPLAY_H
#define QUALITYGATE_DISPLAY_H

/*
 * SPFD5408 / MCUFRIEND parallel TFT driver extracted from the
 * original working QualityGate 2.1 main.c.
 * LCD data: GP6-GP13; RS=14, WR=15, CS=18, RST=19, RD=20.
 * Header-only: static functions avoid duplicate linker definitions.
 */


/*
 * QualityGate 2.1
 * MCUFRIEND SPFD5408 TFT Display
 * Purdue Proton RP2350
 *
 * Full 5x7 ASCII font:
 * Uppercase, lowercase, numbers, punctuation
 */

 #include <stdio.h>
 #include <stdint.h>
 #include "pico/stdlib.h"
 
 // ================= GPIO =================
 
 #define LCD_RS   14
 #define LCD_WR   15
 #define LCD_CS   18
 #define LCD_RST  19
 #define LCD_RD   20
 
 #define WIDTH    240
 #define HEIGHT   320
 
 // Change to 0 to test opposite orientation
 #define FLIP_180 0
 
 // ================= COLORS =================
 
 #define BLACK   0x0000
 #define WHITE   0xFFFF
 #define GREEN   0x07E0
 #define RED     0xF800
 #define BLUE    0x001F
 #define YELLOW  0xFFE0
 #define CYAN    0x07FF
 
 // ================= LCD WRITING =================
 
 static void write8(uint8_t value) {
     gpio_put_masked(0xFFu << 6,
                     (uint32_t)value << 6);
 
     sleep_us(5);
     gpio_put(LCD_WR, 0);
     sleep_us(5);
     gpio_put(LCD_WR, 1);
     sleep_us(5);
 }
 
 static void write16(uint16_t value) {
     write8(value >> 8);
     write8(value & 0xFF);
 }
 
 static void lcd_reg(uint16_t reg, uint16_t value) {
     gpio_put(LCD_CS, 0);
 
     gpio_put(LCD_RS, 0);
     write16(reg);
 
     gpio_put(LCD_RS, 1);
     write16(value);
 
     gpio_put(LCD_CS, 1);
 }
 
 // ================= GPIO INITIALIZATION =================
 
 static void lcd_gpio_init(void) {
     for (int p = 6; p <= 13; p++) {
         gpio_init(p);
         gpio_set_dir(p, GPIO_OUT);
     }
 
     const int pins[] = {
         LCD_RS, LCD_WR, LCD_CS,
         LCD_RST, LCD_RD
     };
 
     for (int i = 0; i < 5; i++) {
         gpio_init(pins[i]);
         gpio_put(pins[i], 1);
         gpio_set_dir(pins[i], GPIO_OUT);
     }
 
     sleep_ms(50);
 
     gpio_put(LCD_RST, 0);
     sleep_ms(100);
     gpio_put(LCD_RST, 1);
     sleep_ms(150);
 }
 
 // ================= ROTATION =================
 
 static void lcd_rotation(void) {
 #if FLIP_180
     lcd_reg(0x0001, 0x0000);
     lcd_reg(0x0060, 0xA700);
 #else
     lcd_reg(0x0001, 0x0100);
     lcd_reg(0x0060, 0x2700);
 #endif
     lcd_reg(0x0003, 0x1030);
 }
 
 // ================= SPFD5408 INIT =================
 
 static void lcd_init(void) {
     lcd_reg(0x00E5, 0x8000);
     lcd_reg(0x0000, 0x0001);
     lcd_reg(0x0001, 0x0100);
     lcd_reg(0x0002, 0x0700);
     lcd_reg(0x0003, 0x1030);
     lcd_reg(0x0004, 0x0000);
 
     lcd_reg(0x0008, 0x0202);
     lcd_reg(0x0009, 0x0000);
     lcd_reg(0x000A, 0x0000);
     lcd_reg(0x000C, 0x0000);
     lcd_reg(0x000D, 0x0000);
     lcd_reg(0x000F, 0x0000);
 
     // Power initialization
     lcd_reg(0x0010, 0x0000);
     lcd_reg(0x0011, 0x0007);
     lcd_reg(0x0012, 0x0000);
     lcd_reg(0x0013, 0x0000);
     sleep_ms(50);
 
     lcd_reg(0x0010, 0x17B0);
     lcd_reg(0x0011, 0x0007);
     sleep_ms(10);
 
     lcd_reg(0x0012, 0x013A);
     sleep_ms(10);
 
     lcd_reg(0x0013, 0x1A00);
     lcd_reg(0x0029, 0x000C);
     sleep_ms(10);
 
     // Gamma
     lcd_reg(0x0030, 0x0000);
     lcd_reg(0x0031, 0x0505);
     lcd_reg(0x0032, 0x0004);
     lcd_reg(0x0035, 0x0006);
     lcd_reg(0x0036, 0x0707);
     lcd_reg(0x0037, 0x0105);
     lcd_reg(0x0038, 0x0002);
     lcd_reg(0x0039, 0x0707);
     lcd_reg(0x003C, 0x0704);
     lcd_reg(0x003D, 0x0807);
 
     // Display area
     lcd_reg(0x0050, 0);
     lcd_reg(0x0051, WIDTH - 1);
     lcd_reg(0x0052, 0);
     lcd_reg(0x0053, HEIGHT - 1);
 
     lcd_reg(0x0060, 0xA700);
     lcd_reg(0x0061, 0x0001);
     lcd_reg(0x006A, 0x0000);
 
     // Panel controls
     lcd_reg(0x0090, 0x0010);
     lcd_reg(0x0092, 0x0000);
     lcd_reg(0x0093, 0x0003);
     lcd_reg(0x0095, 0x0110);
     lcd_reg(0x0097, 0x0000);
     lcd_reg(0x0098, 0x0000);
 
     // Display ON
     lcd_reg(0x0007, 0x0173);
     sleep_ms(100);
 
     lcd_rotation();
 }
 
 // ================= DRAWING =================
 
 // Fill rectangle
 static void lcd_rect(int x, int y, int w, int h,
               uint16_t color) {
 
     if (w <= 0 || h <= 0 ||
         x < 0 || y < 0 ||
         x + w > WIDTH ||
         y + h > HEIGHT) {
         return;
     }
 
     lcd_reg(0x0050, x);
     lcd_reg(0x0051, x + w - 1);
     lcd_reg(0x0052, y);
     lcd_reg(0x0053, y + h - 1);
 
     lcd_reg(0x0020, x);
     lcd_reg(0x0021, y);
 
     gpio_put(LCD_CS, 0);
     gpio_put(LCD_RS, 0);
     write16(0x0022);
     gpio_put(LCD_RS, 1);
 
     for (int i = 0; i < w * h; i++) {
         write16(color);
     }
 
     gpio_put(LCD_CS, 1);
 }
 
 // Clear the full screen
 static void lcd_fill(uint16_t color) {
     lcd_rect(0, 0, WIDTH, HEIGHT, color);
 }
 
 // ================= COMPLETE ASCII FONT =================
 //
 // 95 characters: ASCII 32 through 126
 // Each glyph has 5 columns, 7 pixels tall.
 //
 // Supports A-Z, a-z, 0-9 and punctuation.
 
 static const uint8_t font5x7[95][5] = {
 
     // Space through /
     {0x00,0x00,0x00,0x00,0x00}, // Space
     {0x00,0x00,0x5F,0x00,0x00}, // !
     {0x00,0x07,0x00,0x07,0x00}, // "
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     {0x20,0x10,0x08,0x04,0x02}, // /
 
     // Numbers 0-9
     {0x3E,0x51,0x49,0x45,0x3E}, // 0
     {0x00,0x42,0x7F,0x40,0x00}, // 1
     {0x42,0x61,0x51,0x49,0x46}, // 2
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     {0x06,0x49,0x49,0x29,0x1E}, // 9
 
     // : through @
     {0x00,0x36,0x36,0x00,0x00}, // :
     {0x00,0x56,0x36,0x00,0x00}, // ;
     {0x08,0x14,0x22,0x41,0x00}, // <
     {0x14,0x14,0x14,0x14,0x14}, // =
     {0x00,0x41,0x22,0x14,0x08}, // >
     {0x02,0x01,0x51,0x09,0x06}, // ?
     {0x32,0x49,0x79,0x41,0x3E}, // @
 
     // Uppercase A-Z
     {0x7E,0x11,0x11,0x11,0x7E}, // A
     {0x7F,0x49,0x49,0x49,0x36}, // B
     {0x3E,0x41,0x41,0x41,0x22}, // C
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     {0x61,0x51,0x49,0x45,0x43}, // Z
 
     // [ through `
     {0x00,0x7F,0x41,0x41,0x00}, // [
     {0x02,0x04,0x08,0x10,0x20}, // Backslash
     {0x00,0x41,0x41,0x7F,0x00}, // ]
     {0x04,0x02,0x01,0x02,0x04}, // ^
     {0x40,0x40,0x40,0x40,0x40}, // _
     {0x00,0x01,0x02,0x04,0x00}, // `
 
     // Lowercase a-z
     {0x20,0x54,0x54,0x54,0x78}, // a
     {0x7F,0x48,0x44,0x44,0x38}, // b
     {0x38,0x44,0x44,0x44,0x20}, // c
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     {0x44,0x64,0x54,0x4C,0x44}, // z
 
     // { through ~
     {0x00,0x08,0x36,0x41,0x00}, // {
     {0x00,0x00,0x7F,0x00,0x00}, // |
     {0x00,0x41,0x36,0x08,0x00}, // }
     {0x08,0x04,0x08,0x10,0x08}  // ~
 };
 
 // ================= TEXT DRAWING =================
 
 static void draw_char(int x, int y, char c,
                uint16_t color, int scale) {
 
     unsigned char ch = (unsigned char)c;
 
     if (ch < 32 || ch > 126) {
         ch = '?';
     }
 
     int index = ch - 32;
 
     for (int col = 0; col < 5; col++) {
         uint8_t column = font5x7[index][col];
 
         for (int row = 0; row < 7; row++) {
             if (column & (1u << row)) {
                 lcd_rect(
                     x + col * scale,
                     y + row * scale,
                     scale,
                     scale,
                     color
                 );
             }
         }
     }
 }
 
 static void draw_text(int x, int y,
                const char *text,
                uint16_t color, int scale) {
 
     int start_x = x;
 
     while (*text) {
 
         if (*text == '\n') {
             x = start_x;
             y += 9 * scale;
         }
         else {
             draw_char(x, y, *text, color, scale);
             x += 6 * scale;
         }
 
         text++;
     }
 }

#endif // QUALITYGATE_DISPLAY_H
